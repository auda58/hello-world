AUTOSAR XML (schema 00052)
package /MyECU_DiagnosticExtract
  diagnostic data identifier did1: id=256, data-element=[did1_NewSignal, did1_NewSignal_1, did1_NewSignal_2, did1_NewSignal_3]
  diagnostic data identifier did2: id=512, data-element=[did2_NewSignal, did2_NewSignal_1, did2_NewSignal_2, did2_NewSignal_3]
  diagnostic data identifier did3: id=768, data-element=[did3_NewSignal, did3_NewSignal_1, did3_NewSignal_2, did3_NewSignal_3]
package /MyECU_DataElements
  12 x data:
    did1_NewSignal: type=did1_NewSignal_Type
    did1_NewSignal_{1..3}: type=did1_NewSignal_{1..3}_Type
    did2_NewSignal: type=did2_NewSignal_Type
    did2_NewSignal_{1..3}: type=did2_NewSignal_{1..3}_Type
    did3_NewSignal: type=did3_NewSignal_Type
    did3_NewSignal_{1..3}: type=did3_NewSignal_{1..3}_Type
package /MyECU_DataTypes
  12 x impl type, all with category=VALUE:
    did1_NewSignal_Type: base-type=uint8
    did1_NewSignal_{1..3}_Type: base-type=uint8
    did2_NewSignal_Type: base-type=uint8
    did2_NewSignal_{1..3}_Type: base-type=uint8
    did3_NewSignal_Type: base-type=uint8
    did3_NewSignal_1_Type: base-type=uint8
    did3_NewSignal_2_Type: base-type=sint16
    did3_NewSignal_3_Type: base-type=uint16
package /MyECU_AccessPermissions
  4 x diagnostic access permission:
    did1_Read_Access: service=ReadDataByIdentifier, diag-data-identifier=did1, sessions=Default_Session, security-levels=No_Security
    did2_Read_Access: service=ReadDataByIdentifier, diag-data-identifier=did2, sessions=Default_Session, security-levels=Level_1
    did2_Write_Access: service=WriteDataByIdentifier, diag-data-identifier=did2, sessions=Extended_Session, security-levels=Level_2
    did3_Write_Access: service=WriteDataByIdentifier, diag-data-identifier=did3, sessions=Extended_Session, security-levels=Level_2
